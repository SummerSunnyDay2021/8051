/*
   定时器实验 
   时间： 2016-4-17 9:54 *7

   假设我们需要定时 50 ms，用于 led 的闪烁
 		
 1. TMOD 定时器模式寄存器，TMOD 共 8 位，低 4 位为 timer0， 高 4 位为 timer1
       7，   6，  5，  4， |    3，   2，  1，  0
    GATE， C/T， M1， M0， | GATE， C/T， M1， M0 -- 不可位寻址
    
	这里只涉及 timer0，高 4 位这里不管，
		-- GATE 位， 置 1 用于测量外部信号的周期，这里不用我们置 0
		-- C/T 位， 置 1 用作计时器， 置 0 用于定时器
		-- M1/M0 位设定工作方式
			== 0/0， 兼容 8048 的 13 位定时器模式，我们不用
			== 0/1， 16 位定时模式
			== 1/0， 8 位自动重装，溢出后将 THx 中的值自动重装到 TLx 中
			== 1/1， 禁用 定时器 timer1， 把 timer0 设为两个 8 位定时器
	所以我们的设置值为 8'bXXXX_0001

 2. 设定定时器存储寄存器
 	TH1， TL1， TH0， TL0 --- 复位自动归零
	存储寄存器最多 16 位，即 0x0000 -- 0xFFFF，定时器每个机器周期加 1，而 12 个时钟周期等于 1 个机器周期，假设需要定时 t ms，板上的晶振为 11.0592MHz，那么定时器存储寄存器的计算方法为：
	首先计算晶振周期： 1/(11.0592*10^6) ≈ 9.04*10^-8 s
	计算机器周期： 9.04*10^-8 * 12 ≈ 1.085*10^-6 s
	计算需要的周期数： 50ms = 0.05 s     0.05/(1.085*10^-6) ≈ 46083
	最后得到需要的值： 0xFFFF = 65535 65535 - 46083 = 19452  19452 = 0x4BFC
	TH0 = 0x4B, TL0 = 0xFC
	

 3. TCON—定时器控制寄存器
 	  7，  6，  5，  4，  3，  2，  1，  0
 	TF1，TR1，TF0，TR0，IE1，IT1，IE0，IT0 -- 可位寻址
 		-- TF0， 定时器 timer0 溢出标识位，溢出后硬件置 1，需要软件清零或者使用定时器中断硬件清零
 		-- TR0， 定时器 timer0 控制位，置 1 启动定时器，置 0 停止定时器
 		-- IE0 和 IT0 用于外部中断，这里先不管
**/


#include <reg52.h>

sbit LED0 = P0^0;
sbit ADDR0 = P1^0;
sbit ADDR1 = P1^1;
sbit ADDR2 = P1^2;
sbit ADDR3 = P1^3;
sbit ENLED = P1^4;

void main(void) {
//*******************//
	ADDR0 = 0;
	ADDR1 = 1;
	ADDR2 = 1;
	ADDR3 = 1;
	ENLED = 0;	
//******************//
	TMOD = 0x01;
	TH0 = 0x4B;
	TL0 = 0xFC;
	TR0 = 1;
//*****************//
	while(1){
		unsigned char cnt;
		if(TF0) {
			cnt = cnt + 1;
			TF0 = 0;
			TH0 = 0x4B;
			TL0 = 0xFC;
			if(cnt>=10) {
				LED0 = !LED0;
				cnt = 0;
			}	
		}
			
	}
}
